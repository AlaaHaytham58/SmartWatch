	AREA MYDATA, DATA, READWRITE
	AREA	MYCODE, CODE, READONLY
	;IMPORT LCD_DATA_WRITE
	;IMPORT ADDRESS_SET
	INCLUDE Setup.s
	;EXPORT Digits_Main

;ENDFN
;	POP {R0-R12, PC}
;	ENDFUNC

DRAW_COLLEN FUNCTION
	PUSH{R0-R12, LR}
	
	MOV R0,#120
	MOV R1,#150
	
	ADD R3,R0,#20
	ADD R4,R1,#20
	ldr r10,= BLACK
	BL DRAW_RECTANGLE_FILLED
	
	MOV R0,#120
	MOV R1,#190
	ADD R3,R0,#20
	ADD R4,R1,#20
	ldr r10,= BLACK
	BL DRAW_RECTANGLE_FILLED
	
	POP {R0-R12,PC}
	ENDFUNC
	
DRAW_RECTANGLE_FILLED FUNCTION
	;TODO: IMPLEMENT THIS FUNCTION ENTIRELY, AND SPECIFY THE ARGUMENTS IN COMMENTS, WE DRAW A RECTANGLE BY SPECIFYING ITS TOP-LEFT AND LOWER-RIGHT POINTS, THEN FILL IT WITH THE SAME COLOR
	;X1 = [] r0
	;Y1 = [] r1
	;X2 = [] r3
	;Y2 = [] r4
	;COLOR = [] r10
	PUSH {R0-R12, LR}
	

	
	mov r9, r1
	mov r1, r3
	mov r3, r9
	
	BL ADDRESS_SET
	


	sub r11, r1, r0
	sub r12, r4, r3
	mul r11, r11, r12

loop

	mov r5, r10, lsr #8
	mov r2, r5
	BL LCD_DATA_WRITE
	mov r2, r10
	BL LCD_DATA_WRITE
	
	subs r11, #1
	bne loop
	
	POP {R0-R12, PC}
	ENDFUNC
	END
;ENTRY

